## CMakeLists.txt
```
# Copyright (C) metraTec GmbH - All Rights Reserved
# Unauthorized copying of this file, via any medium is strictly prohibited
# Proprietary and confidential
# Written by Gerhard Jörges <joerges@metratec.com>, March 2022

cmake_minimum_required(VERSION 3.22.1)

# Find Zephyr. This also loads Zephyr's build system.
find_package(Zephyr REQUIRED HINTS $ENV{ZEPHYR_BASE})
project(app)

# treat warnings as errors in project files
zephyr_library_compile_options(-Wall -Werror)

# Add your source file to the "app" target. This must come after
# find_package(Zephyr) which defines the target.
target_sources(app PRIVATE
    src/main.c
)
```

## Kconfig
```
# Copyright (C) metraTec GmbH - All Rights Reserved
# Unauthorized copying of this file, via any medium is strictly prohibited
# Proprietary and confidential
# Written by Gerhard Jörges <joerges@metratec.com>, March 2022

module = APP
module-str = APP
source "subsys/logging/Kconfig.template.log_config"

menu "Zephyr"
source "Kconfig.zephyr"
endmenu
```

## west.yml
```
# Copyright (C) metraTec GmbH - All Rights Reserved
# Unauthorized copying of this file, via any medium is strictly prohibited
# Proprietary and confidential
# Written by Gerhard Jörges <joerges@metratec.com>, March 2022

manifest:
  remotes:
    - name: zephyrproject
      url-base: https://github.com/zephyrproject-rtos
  projects:
    - name: zephyr
      remote: zephyrproject
      revision: 68f63246a001d5092230e7ebc8c22b293a207c77
      import:
        name-whitelist:
          - cmsis
          - hal_nordic
```

## prj.conf
```kconfig
# Copyright (C) metraTec GmbH - All Rights Reserved
# Unauthorized copying of this file, via any medium is strictly prohibited
# Proprietary and confidential
# Written by Gerhard Jörges <joerges@metratec.com>, March 2022

CONFIG_CLOCK_CONTROL_NRF_K32SRC_RC=y
CONFIG_CLOCK_CONTROL_NRF_K32SRC_250PPM=y

CONFIG_GPIO=y
CONFIG_SERIAL=n
```

## test.conf
```kconfig
# Copyright (C) metraTec GmbH - All Rights Reserved
# Unauthorized copying of this file, via any medium is strictly prohibited
# Proprietary and confidential
# Written by Gerhard Jörges <joerges@metratec.com>, March 2022

CONFIG_SOC_NRF52833_QIAA=n
CONFIG_SOC_NRF52840_QIAA=y
```

## src/main.c
```c
/* Copyright (C) metraTec GmbH - All Rights Reserved
 * Unauthorized copying of this file, via any medium is strictly prohibited
 * Proprietary and confidential
 * Written by Gerhard Jörges <joerges@metratec.com>, March 2022
 */

#include <drivers/gpio.h>

/******************************************************************************/

void main(void)
{
    /* setup LEDs */
    struct gpio_dt_spec led0 =
        GPIO_DT_SPEC_GET_OR(DT_ALIAS(led0), gpios, { 0 });
    gpio_pin_configure_dt(&led0, GPIO_OUTPUT_INACTIVE);

    while (1) {
        k_sleep(K_MSEC(9975));
        gpio_pin_toggle_dt(&led0);
        k_sleep(K_MSEC(25));
        gpio_pin_toggle_dt(&led0);
    }
}
```
